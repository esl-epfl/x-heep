/dts-v1/;
/plugin/;

/{
	fragment@0{
		target-path = "/aliases";
		__overlay__ {
			serial1 = "/axi/serial@e0001000";	
		};
	};

	fragment@1{
		target = <&uart1>;
		__overlay__ {
			status = "okay";
		};
	};
};
